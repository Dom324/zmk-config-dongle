## config/west.yml
```yaml
manifest:
  remotes:
    - name: zmkfirmware
      url-base: https://github.com/zmkfirmware
    - name: urob
      url-base: https://github.com/urob
  projects:
    - name: zmk-helpers
      remote: urob
      revision: 859bf060ea7c17f552f8da59fc2677de5e3f5531
      path: modules/helpers
    - name: zmk
      remote: urob
      revision: 75334549c1e0876c74d5e1ebf600db5b99a57022
      import: app/west.yml
  self:
    path: config
```
